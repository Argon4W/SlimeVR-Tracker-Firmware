#include "tgmath.h"
#include "sdkconfig.h"
#include "esp_check.h"
#include "esp_log.h"
#include "nvs.h"
#include "nvs_flash.h"
#include "freertos/FreeRTOS.h"
#include "freertos/task.h"
#include "lsm6dsv_reg.h"
#include "qmc6309_reg.h"
#include "slime_main.h"

static const char* TAG = "slime_main";

static const uint16_t logo_bitmap_data[5184] = {
0x39E7, 0x39E7, 0x39E7, 0x39E7, 0x39E7, 0x39E7, 0x39E7, 0x39E7, 0x39E7, 0x39E7, 0x39E7, 0x39E7,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 0x39E7,
0x39E7, 0x39E7, 0x39E7, 0x39E7, 0x39E7, 0x39E7, 0x39E7, 0x39E7, 0x39E7, 0x39E7, 0x39E7, 0x39E7,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 0x39E7,
0x39E7, 0x39E7, 0x39E7, 0x39E7, 0x39E7, 0x39E7, 0x39E7, 0x39E7, 0x39E7, 0x39E7, 0x39E7, 0x39E7,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 0x39E7,
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0x39E7, 0x39E7, 0x39E7, 0x39E7, 0x39E7, 0x39E7, 0x39E7, 0x39E7, 0x39E7, 0x39E7, 0x39E7, 0x39E7,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 0x39E7,
};

static const slime_screen_bitmap_info_t logo_bitmap = {
	.data_color_type	= RGB565,
	.data_optimized		= false,
	.data_size_x		= 96,
	.bitmap_data_0		= logo_bitmap_data,
	.bitmap_data_1		= NULL
};

// The green text style for normal display.
slime_screen_text_style_t text_style_green = {
	.color_type		= RGBA8888,
	.color_text		= 0x00FF00FFU,
	.color_outline	= 0x007F00FFU,
	.outlined		= true
};

// The red text style for important notices.
slime_screen_text_style_t text_style_red = {
	.color_type		= RGBA8888,
	.color_text		= 0xFF0000FFU,
	.color_outline	= 0x7F0000FFU,
	.outlined		= true
};

// The yellow text style for warnings.
slime_screen_text_style_t text_style_yellow = {
	.color_type		= RGBA8888,
	.color_text		= 0xFFFF00FFU,
	.color_outline	= 0x7F7F00FFU,
	.outlined		= true
};

typedef struct {
	slime_magneto_context_t*	magneto_context;
	slime_fusion_context_t*		fusion_context;
	ceigen_matrix_handle_t		gyroscope;
	ceigen_matrix_handle_t		accelerometer;
	ceigen_matrix_handle_t		magnetometer;
	ceigen_matrix_handle_t		magneto;
	ceigen_quaternion_handle_t	quaternion;
	ceigen_matrix_handle_t		rotation_matrix;
	ceigen_matrix_handle_t		euler_angles;
	uint8_t						calibrating;
} slime_main_context_t;

void slime_main_on_gyroscope(
	const	slime_sensor_context_t*	sensor_context,
	const	float_t					gyroscope_dps_frd_x,
	const	float_t					gyroscope_dps_frd_y,
	const	float_t					gyroscope_dps_frd_z,
			void*					user_context
) {
	// Get the handles of vectors from the main context.
	const slime_main_context_t* main_context = (slime_main_context_t*) user_context;

	// Load the raw gyroscope output to the CEigen vector.
	ceigen_set_matrix_coefficient(main_context->gyroscope, 0U, 0U, gyroscope_dps_frd_x);
	ceigen_set_matrix_coefficient(main_context->gyroscope, 1U, 0U, gyroscope_dps_frd_y);
	ceigen_set_matrix_coefficient(main_context->gyroscope, 2U, 0U, gyroscope_dps_frd_z);

	// Skip if calibrating.
	if (!main_context->calibrating) {
		// Performs gyroscope update step.
		slime_fusion_update_gyroscope(
			/* fusion_context		= */ main_context->fusion_context,
			/* gyroscope_mdps_frd	= */ main_context->gyroscope
		);
	}
}

void slime_main_on_accelerometer(
	const	slime_sensor_context_t*	sensor_context,
	const	float_t					accelerometer_mg_frd_x,
	const	float_t					accelerometer_mg_frd_y,
	const	float_t					accelerometer_mg_frd_z,
			void*					user_context
) {
	// Get the handles of vectors from the main context.
	const slime_main_context_t* main_context = (slime_main_context_t*) user_context;

	// Load the raw accelerometer output to the CEigen vector.
	ceigen_set_matrix_coefficient(main_context->accelerometer, 0U, 0U, accelerometer_mg_frd_x);
	ceigen_set_matrix_coefficient(main_context->accelerometer, 1U, 0U, accelerometer_mg_frd_y);
	ceigen_set_matrix_coefficient(main_context->accelerometer, 2U, 0U, accelerometer_mg_frd_z);

	// Skip if calibrating.
	if (!main_context->calibrating) {
		// Performs accelerometer update step.
		slime_fusion_update_accelerometer(
			/* fusion_context		= */ main_context->fusion_context,
			/* accelerometer_mg_frd	= */ main_context->accelerometer
		);
	}
}

void slime_main_on_magnetometer(
	const	slime_sensor_context_t*	sensor_context,
	const	float_t					magnetometer_gauss_frd_x,
	const	float_t					magnetometer_gauss_frd_y,
	const	float_t					magnetometer_gauss_frd_z,
			void*					user_context
) {
	slime_main_context_t*		main_context	= (slime_main_context_t*) user_context;
	slime_magneto_context_t*	magneto_context	= main_context->magneto_context;

	if (main_context->calibrating) {
		if (magneto_context->sample_container->sample_norm_count < 45U * 50U) {
			// Collect the raw magnetometer output samples if the sample count is not enough.
			slime_magneto_collect_sample(
				/* magneto_context	= */ magneto_context,
				/* sample_x			= */ magnetometer_gauss_frd_x,
				/* sample_y			= */ magnetometer_gauss_frd_y,
				/* sample_z			= */ magnetometer_gauss_frd_z
			);
			ESP_LOGI(TAG, "Magnetometer calibration raw data output: %.2f, %.2f, %.2f",
				/* f */ magnetometer_gauss_frd_x,
				/* f */ magnetometer_gauss_frd_y,
				/* f */ magnetometer_gauss_frd_z
			);
		} else {
			// If the sample count is enough, calculate the calibration coefficients.
			slime_magneto_calculate_calibration_coefficients(magneto_context);

			// Reset the fusion.
			slime_fusion_reset(main_context->fusion_context);

			// Stop calibrating.
			main_context->calibrating = false;
		}
	} else if (main_context->magneto_context->valid) {
		// Load the raw magnetometer data into the magneto calibration input vector.
		ceigen_set_matrix_coefficient(main_context->magnetometer, 0U, 0U, magnetometer_gauss_frd_x);
		ceigen_set_matrix_coefficient(main_context->magnetometer, 1U, 0U, magnetometer_gauss_frd_y);
		ceigen_set_matrix_coefficient(main_context->magnetometer, 2U, 0U, magnetometer_gauss_frd_z);

		// Apply the calibration coefficients to the raw magnetometer output.
		slime_magneto_apply_calibration_coefficients(
			/* magneto_context	= */ magneto_context,
			/* src_vector		= */ main_context->magnetometer,
			/* dst_vector		= */ main_context->magneto
		);

		// Performs magnetometer update step.
		slime_fusion_update_magnetometer(
			/* fusion_context			= */ main_context->fusion_context,
			/* magnetometer_gauss_frd	= */ main_context->magneto
		);
	}
}

void app_main(void) {
	slime_sensor_error_t	err = SLIME_SENSOR_OK();
	esp_err_t				ret = ESP_OK;

	slime_nvs_context_t*		nvs_context		= NULL;
	slime_gpio_context_t*		gpio_context	= NULL;
	slime_i2c_context_t*		i2c_context		= NULL;
	slime_lcd_context_t*		lcd_context		= NULL;
	slime_screen_context_t*		screen_context	= NULL;
	slime_button_context_t*		button_context	= NULL;
	slime_magneto_context_t*	magneto_context	= NULL;
	slime_sensor_context_t*		sensor_context	= NULL;
	slime_fusion_context_t*		fusion_context	= NULL;

	uint32_t loop_frame = 0U;

	slime_main_context_t*		main_context	= NULL;
	ceigen_matrix_handle_t		gyroscope		= NULL;
	ceigen_matrix_handle_t		accelerometer	= NULL;
	ceigen_matrix_handle_t		magnetometer	= NULL;
	ceigen_matrix_handle_t		magneto			= NULL;
	ceigen_matrix_handle_t		euler_angles	= NULL;
	ceigen_matrix_handle_t		rotation_matrix	= NULL;
	ceigen_quaternion_handle_t	quaternion		= NULL;
	ceigen_quaternion_handle_t	ned_to_enu		= NULL;

	ESP_GOTO_ON_ERROR(					slime_nvs_context_new		(&nvs_context,		&nvs_context_config),											error, TAG, "Failed to create NVS context.");
	ESP_GOTO_ON_ERROR(					slime_gpio_context_new		(&gpio_context,		&gpio_context_config),											error, TAG, "Failed to create GPIO context.");
	ESP_GOTO_ON_ERROR(					slime_i2c_context_new		(&i2c_context,		&i2c_context_config),											error, TAG, "Failed to create I2C context.");
	ESP_GOTO_ON_ERROR(					slime_lcd_context_new		(&lcd_context,		&lcd_context_config,	gpio_context),							error, TAG, "Failed to create LCD context.");
	ESP_GOTO_ON_ERROR(					slime_screen_context_new	(&screen_context,	&screen_context_config,	lcd_context),							error, TAG, "Failed to create screen context.");
	ESP_GOTO_ON_ERROR(					slime_button_context_new	(&button_context,	&button_context_config),										error, TAG, "Failed to create button context.");
	ESP_GOTO_ON_ERROR(					slime_magneto_context_new	(&magneto_context,	&slime_magneto_context_config, nvs_context),					error, TAG, "Failed to create magneto context.");
	ESP_GOTO_ON_ERROR(SLIME_ESP_ERROR(	slime_sensor_context_new	(&sensor_context,	slime_sensor_context_type_table, gpio_context, i2c_context)),	error, TAG, "Failed to create sensor context.");
	ESP_GOTO_ON_ERROR(					slime_fusion_context_new	(&fusion_context,	slime_fusion_context_type_table, sensor_context, 0U),			error, TAG, "Failed to create fusion context.");

	main_context	= calloc				(1U, sizeof(slime_main_context_t));
	gyroscope		= ceigen_new_matrix		(3U, 1U);
	accelerometer	= ceigen_new_matrix		(3U, 1U);
	magnetometer	= ceigen_new_matrix		(3U, 1U);
	magneto			= ceigen_new_matrix		(3U, 1U);
	euler_angles	= ceigen_new_matrix		(3U, 1U);
	rotation_matrix	= ceigen_new_matrix		(3U, 3U);
	quaternion		= ceigen_new_quaternion	();
	ned_to_enu		= ceigen_new_quaternion	();

	ESP_GOTO_ON_FALSE(main_context		!= NULL, ESP_ERR_NO_MEM, error, TAG, "Failed to create main context.");
	ESP_GOTO_ON_FALSE(gyroscope			!= NULL, ESP_ERR_NO_MEM, error, TAG, "Failed to create gyroscope vector.");
	ESP_GOTO_ON_FALSE(accelerometer		!= NULL, ESP_ERR_NO_MEM, error, TAG, "Failed to create accelerometer vector.");
	ESP_GOTO_ON_FALSE(magnetometer		!= NULL, ESP_ERR_NO_MEM, error, TAG, "Failed to create magnetometer vector.");
	ESP_GOTO_ON_FALSE(magneto			!= NULL, ESP_ERR_NO_MEM, error, TAG, "Failed to create magneto vector.");
	ESP_GOTO_ON_FALSE(euler_angles		!= NULL, ESP_ERR_NO_MEM, error, TAG, "Failed to create euler angles vector.");
	ESP_GOTO_ON_FALSE(rotation_matrix	!= NULL, ESP_ERR_NO_MEM, error, TAG, "Failed to create rotation matrix.");
	ESP_GOTO_ON_FALSE(quaternion		!= NULL, ESP_ERR_NO_MEM, error, TAG, "Failed to create quaternion.");
	ESP_GOTO_ON_FALSE(ned_to_enu		!= NULL, ESP_ERR_NO_MEM, error, TAG, "Failed to create coordinate system conversion quaternion.");
	ESP_GOTO_ON_FALSE(fusion_context	!= NULL, ESP_ERR_NO_MEM, error, TAG, "Failed to create fusion context.");

	ceigen_set_quaternion_w(ned_to_enu, 0);
	ceigen_set_quaternion_x(ned_to_enu, M_SQRT1_2);
	ceigen_set_quaternion_y(ned_to_enu, M_SQRT1_2);
	ceigen_set_quaternion_w(ned_to_enu, 0);

	const slime_sensor_callbacks_config_t sensor_callbacks = {
		.timestamp_callback		= NULL,
		.gyroscope_callback		= slime_main_on_gyroscope,
		.accelerometer_callback	= slime_main_on_accelerometer,
		.magnetometer_callback	= slime_main_on_magnetometer
	};

	ESP_GOTO_ON_ERROR(slime_sensor_register_callbacks(
		/* sensor_context	= */ sensor_context,
		/* sensor_callbacks	= */ &sensor_callbacks,
		/* user_context		= */ main_context
	), error, TAG, "Failed to register accelerometer FIFO callback.");

	main_context->magneto_context	= magneto_context;
	main_context->fusion_context	= fusion_context;
	main_context->gyroscope			= gyroscope;
	main_context->accelerometer		= accelerometer;
	main_context->magnetometer		= magnetometer;
	main_context->magneto			= magneto;
	main_context->quaternion		= quaternion;
	main_context->rotation_matrix	= rotation_matrix;
	main_context->euler_angles		= euler_angles;
	main_context->calibrating		= false;

	slime_gpio_led_set_level(gpio_context, 1);

	// Clear the screen content to pure black to prevent glitches after the backlight is on.
	slime_screen_draw_rectangle(
		/* screen_context	= */ screen_context,
		/* position_x		= */ 0,
		/* position_y		= */ 0,
		/* size_x			= */ 96,
		/* size_y			= */ 54,
		/* color_rgba8888	= */ 0x000000FFU
	);

	// Commit the changes to screen.
	slime_screen_commit(screen_context);

	// Wait for the changes to be transmitted to the LCD panel.
	vTaskDelay(pdMS_TO_TICKS(50U));

	// Turn on the display.
	slime_screen_set_backlight(screen_context, 1U);

	// Fade in the LOGO.
	for (uint32_t percent = 0U; percent <= 100U; percent ++) {
		const uint32_t alpha = (255U * percent / 100U);

		// Clear the background.
		slime_screen_draw_rectangle(
			/* screen_context	= */ screen_context,
			/* position_x		= */ 0,
			/* position_y		= */ 0,
			/* size_x			= */ 96,
			/* size_y			= */ 54,
			/* color_rgba8888	= */ 0xFFFFFFFFU
		);

		// Draw the fading-in LOGO bitmap.
		slime_screen_draw_bitmap(
			/* screen_context		= */ screen_context,
			/* bitmap_info			= */ &logo_bitmap,
			/* position_x			= */ 0,
			/* position_y			= */ 0,
			/* size_x				= */ 96U,
			/* size_y				= */ 54U,
			/* bitmap_offset_x		= */ 0U,
			/* bitmap_offset_x		= */ 0U,
			/* bitmap_a8_multiplier	= */ (uint8_t) alpha
		);

		// Commit changes to the screen.
		slime_screen_commit(screen_context);

		// Delay.
		vTaskDelay(pdMS_TO_TICKS(5U));
	}

	// Show the logo for 2 seconds.
	vTaskDelay(pdMS_TO_TICKS(2000U));

	while (true) {
		if ((loop_frame ++) % 5U == 0U) {
			slime_screen_draw_rectangle(
				/* screen_context	= */ screen_context,
				/* position_x		= */ 0,
				/* position_y		= */ 0,
				/* size_x			= */ 96,
				/* size_y			= */ 54,
				/* color_rgba8888	= */ 0x000000FFU
			);

			if (main_context->calibrating) {
				slime_screen_draw_string(
					/* screen_context	= */ screen_context,
					/* text_style		= */ &text_style_yellow,
					/* position_x		= */ 21,
					/* position_y		= */ 11,
					/* string			= */ "校准中"
				);

				slime_screen_draw_string_fmt(
					/* screen_context	= */ screen_context,
					/* text_style		= */ &text_style_yellow,
					/* position_x		= */ 29,
					/* position_y		= */ 28,
					/* string			= */ "%03" PRIu32 "%%",
					/* PRIu32			= */ ((magneto_context->sample_container->sample_norm_count * 100U) / (45U * 50U))
				);
			} else {
				// Update the 9D quaternion in main context.
				slime_fusion_get_orientation(
					/* fusion_context			= */ main_context->fusion_context,
					/* quaternion_ned_6D_out	= */ NULL,
					/* quaternion_ned_9D_out	= */ main_context->quaternion
				);

				// Convert the quaternion to rotation matrix.
				ceigen_quaternion_to_rotation_matrix(
					/* source_quaternion	= */ main_context->quaternion,
					/* destination_matrix	= */ main_context->rotation_matrix
				);

				const float_t m00 = ceigen_get_matrix_coefficient(main_context->rotation_matrix, 0U, 0U);
				const float_t m01 = ceigen_get_matrix_coefficient(main_context->rotation_matrix, 0U, 1U);

				const float_t m10 = ceigen_get_matrix_coefficient(main_context->rotation_matrix, 1U, 0U);
				const float_t m11 = ceigen_get_matrix_coefficient(main_context->rotation_matrix, 1U, 1U);

				const float_t m20 = ceigen_get_matrix_coefficient(main_context->rotation_matrix, 2U, 0U);
				const float_t m21 = ceigen_get_matrix_coefficient(main_context->rotation_matrix, 2U, 1U);
				const float_t m22 = ceigen_get_matrix_coefficient(main_context->rotation_matrix, 2U, 2U);

				const float_t sy = sqrt(
					m00 * m00 +
					m10 * m10
				);

				float_t yaw;
				float_t pitch;
				float_t roll;

				if (sy > 1e-6f) {
					yaw		= atan2(+m10, +m00);
					pitch	= atan2(-m20, +sy);
					roll	= atan2(+m21, +m22);
				} else {
					yaw		= atan2(-m01, +m11);
					pitch	= atan2(-m20, +sy);
					roll	= 0.0f;
				}

				yaw		*= 180.0f / M_PI;
				pitch	*= 180.0f / M_PI;
				roll	*= 180.0f / M_PI;

				slime_screen_draw_string_fmt(
					/* screen_context	= */ screen_context,
					/* text_style		= */ &text_style_green,
					/* position_x		= */ 5,
					/* position_y		= */ 0,
					/* string			= */ "Y: %.2f\nP: %.2f\nR: %.2f",
					/* f				= */ yaw,
					/* f				= */ pitch,
					/* f				= */ roll
				);
			}

			slime_screen_commit(screen_context);
		}

		switch (slime_button_poll_event(button_context)) {
			case BUTTON_SWITCH:
				// Start the calibration if the button is pressed.
				if (!main_context->calibrating) {
					main_context->calibrating = true;

					// Clear the samples in the sample container and reset the calibration coefficients.
					slime_magneto_clear_samples					(magneto_context);
					slime_magneto_reset_calibration_coefficients(magneto_context);
				}
				break;
			case BUTTON_RETURN:
				ESP_LOGI(TAG, "Return button pressed.");
				break;
			case BUTTON_CONFIRM:
				ESP_LOGI(TAG, "Confirm button pressed.");
				break;
			default:
				break;
		}

		ESP_GOTO_ON_ERROR(SLIME_ESP_ERROR(slime_sensor_poll_fifo(sensor_context)), error, TAG, "Failed to poll FIFO data of the sensor context.");
	}

	error:

	ESP_LOGE(TAG, "Error occurred: 0x%" PRIX8 ": %s", ret, esp_err_to_name(ret));
	ESP_LOGE(TAG, "Cleaning up resources.");

	if (screen_context) {
		slime_screen_draw_rectangle(
			/* screen_context	= */ screen_context,
			/* position_x		= */ 0,
			/* position_y		= */ 0,
			/* size_x			= */ 96,
			/* size_y			= */ 54,
			/* color_rgba8888	= */ 0x000000FFU
		);

		if (err.error_type == IMU_ERROR) {
			slime_screen_draw_string(
				/* screen_context			= */ screen_context,
				/* text_style				= */ &text_style_red,
				/* position_x				= */ 15,
				/* position_y				= */ 18,
				/* string					= */ "IMU错误"
			);
		} else if (err.error_type == MAG_ERROR) {
			slime_screen_draw_string(
				/* screen_context			= */ screen_context,
				/* text_style				= */ &text_style_red,
				/* position_x				= */ 3,
				/* position_y				= */ 18,
				/* string					= */ "磁力计错误"
			);
		} else {
			slime_screen_draw_string(
				/* screen_context			= */ screen_context,
				/* text_style				= */ &text_style_yellow,
				/* position_x				= */ 12,
				/* position_y				= */ 18,
				/* string					= */ "程序错误"
			);
		}

		slime_screen_commit(screen_context);
	}

	while (1) {
		if (err.error_type == IMU_ERROR) {
			slime_gpio_led_set_level(gpio_context, 0);
			vTaskDelay(pdMS_TO_TICKS(50U));
			slime_gpio_led_set_level(gpio_context, 1);
			vTaskDelay(pdMS_TO_TICKS(50U));
		} else if (err.error_type == MAG_ERROR) {
			slime_gpio_led_set_level(gpio_context, 0);
			vTaskDelay(pdMS_TO_TICKS(200U));
			slime_gpio_led_set_level(gpio_context, 1);
			vTaskDelay(pdMS_TO_TICKS(200U));
		} else {
			slime_gpio_led_set_level(gpio_context, 0);
			vTaskDelay(pdMS_TO_TICKS(1000U));
			slime_gpio_led_set_level(gpio_context, 1);
			vTaskDelay(pdMS_TO_TICKS(1000U));
		}
	}
}